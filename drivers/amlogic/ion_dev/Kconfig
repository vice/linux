## drivers/amlogic/ion_dev/Kconfig
```kconfig
menu "ION support"

config AMLOGIC_ION
	tristate "ION memory management support"
	select ION
	select ARM_HAS_SG_CHAIN
	select ARM64_HAS_SG_CHAIN
	default n
	---help---
	Select to enable "Amlogic ion device support.
endmenu
```
